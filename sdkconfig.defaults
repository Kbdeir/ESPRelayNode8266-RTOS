## sdkconfig.defaults
```kconfig
CONFIG_PARTITION_TABLE_CUSTOM=y
CONFIG_PARTITION_TABLE_CUSTOM_FILENAME="partitions.csv"
CONFIG_ESPTOOLPY_FLASHSIZE_4MB=y
CONFIG_FREERTOS_WATCHDOG=y
CONFIG_FREERTOS_CHECK_STACKOVERFLOW=y
CONFIG_LWIP_IPV6=n
CONFIG_MBEDTLS_DYNAMIC_BUFFER=y
# CONFIG_NEWLIB_NANO_FORMAT is not set
CONFIG_ESPTOOLPY_MONITOR_BAUD_115200B=y
CONFIG_ESP_CONSOLE_UART_BAUDRATE=115200
CONFIG_HTTPD_MAX_REQ_HDR_LEN=1024
```
